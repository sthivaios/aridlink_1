## firmware/main/Kconfig.projbuild
```kconfig
menu "AridLink Configuration"

    config ARIDLINK_AWS_ENDPOINT
        string "AWS IoT Endpoint"
        default ""

    config PPP_CONN_MAX_RETRY
        int "PPP over LTE max retries"
        default 3

    config LTE_MODEM_UART_BAUD_RATE
        int "LTE modem UART baud rate"
        default 115200

endmenu

menu "AridLink Development Tools"

    menu "MEMLOG Task"

        config MEMLOG_TASK_ENABLED
                bool "Enable the UART memory logging RTOS task"
                default n
                help
                    Enables a task that logs the heap usage every second, in a CSV format, over UART.

        config MEMLOG_TASK_UART_PIN
                int "The pin used for the memory logging task's UART comms"
                default 40

    endmenu

endmenu
```
